## config/west.yml
```yaml
manifest:
  remotes:
    - name: zmkfirmware
      url_base: https://github.com/zmkfirmware
    - name: h_m_m_v
      url_base: https://github.com/hype-m-m-v
  projects:
    - name: zmk
      remote: h_m_m_v
      revision: eyelash_corne
      import: app/west.yml
  self:
    path: config
```
